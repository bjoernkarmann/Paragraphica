// tool to convert image to c array:
// https://notisrac.github.io/FileToCArray/


#define HEADER_HEIGHT 30
#define TFT_WHITE ILI9341_WHITE
#define TFT_RED ILI9341_RED
#define TFT_GRAY ILI9341_DARKGREY
#define TFT_GREEN ILI9341_DARKGREEN
#define TEXT_SIZE 1.2  
#define MARGIN 5 

// array size is 1740
const PROGMEM uint8_t qrCodeURL[] = {
  0x00, 0x00, 0x00, 0x00, 0xf0, 0xf0, 0xf0, 0xf0, 0xf0, 0xf0, 0xf0, 0xf0, 0xf0, 0xf0, 0xf0, 
  0xf0, 0xf0, 0xf0, 0xf0, 0xf0, 0xf0, 0xf0, 0xf0, 0xf0, 0x00, 0x00, 0x00, 0x00, 0xff, 0xff, 
  0xff, 0xff, 0x0f, 0x0f, 0x0f, 0x0f, 0xf0, 0xf0, 0xf0, 0xf0, 0x0f, 0x0f, 0x0f, 0x0f, 0xff, 
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  0x0f, 0x0f, 0x0f, 0x00, 0x00, 0x00, 0x00, 0x0f, 0x0f, 0x0f, 0x0f, 0x00, 0x00, 0x00, 0x00
};

// array size is 112
const PROGMEM uint8_t qrCodeWIFI[] = {
  0x00, 0xef, 0xfa, 0x40, 0x1f, 
  0xa5, 0x0d, 0x77, 0xe4, 0x29, 
  0xa6, 0x3d, 0x09, 0x0b, 0xe9, 
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  0x00, 0x21, 0x8c, 0x63
};

void updateScreenByMode(int currentPage){

  int qr_scale = 3; // Adjust this to increase the scale factor

  displayQRCode(qrCodeWIFI, 50, 50, qr_scale);

  displayQRCode(qrCodeWIFI, 200, 50, qr_scale);

}

void updateHeader(bool wifiStatus, float lat, float lng, int page, bool sdStatus) {
  // Clear the header area first

  // draw header background bar, if all connections are good turn the bar green.
  if(wifiStatus && lat != 0 && sdStatus){
    tft.fillRect(0, 0, tft.width(), HEADER_HEIGHT, TFT_GRAY);
    cameraReady = true;
  }else{
    tft.fillRect(0, 0, tft.width(), HEADER_HEIGHT, TFT_RED);
    cameraReady = false;
  }
  

  // Set the size for the header text
  tft.setTextSize(TEXT_SIZE);
  tft.setTextColor(TFT_WHITE);

  // Display WiFi status on the top left
  tft.setCursor(MARGIN, MARGIN);
  if (wifiStatus) {
    tft.print("WiFi: Connected");
  } else {
    tft.print("WiFi: Disconnected");
  }

  // Display lat and lon below WiFi status
  tft.setCursor(MARGIN, MARGIN + TEXT_SIZE * 10);  // Adjust y-coordinate based on text size
  if (lat == 0) {
    tft.print("GPS: Searching...");
  } else {
    tft.print("Lat: " + String(lat, 6) + " Lng: " + String(lng, 6));
  }

  // Display page number on the top right
  String pageStr = "Mode: " + String(page) + "/3";

  int pageStrWidth = pageStr.length() * 6 * TEXT_SIZE;  // Approximate width calculation based on 6px width for each char
  tft.setCursor(MARGIN + tft.width() - pageStrWidth, MARGIN);  // Position x-coordinate to align text to right
  tft.print(pageStr);

  // Display SD card status below page number
  if (!sdStatus) {
    String sdStr = "No Micro SD";
    int sdStrWidth = sdStr.length() * 6 * TEXT_SIZE;  // Approximate width calculation based on 6px width for each char
    tft.setCursor(MARGIN + tft.width() - sdStrWidth, MARGIN + TEXT_SIZE * 10); // Position right below the page number
    tft.print(sdStr);
  }


}

void displayQRCode(const uint8_t *qrCode, int x, int y, int scale) {
  int totalPixels = sizeof(qrCode) * 8;  // Total number of pixels in the QR code
  int width = sqrt(totalPixels);         // Width of the QR code
  int height = width;                    // Height of the QR code (same as width since it's square)

  for (int j = 0; j < height; j++) {
    for (int i = 0; i < width; i++) {
      uint8_t byteValue = pgm_read_byte_near(qrCode + (j * width + i) / 8);
      uint8_t bitValue = (byteValue >> (7 - (i % 8))) & 0x01;

      int color = bitValue ? ILI9341_WHITE : ILI9341_BLACK;
      tft.fillRect(x + i * scale, y + j * scale, scale, scale, color);
    }
  }
}

void backlightOn() {
  digitalWrite(TFT_LITE, HIGH);
}

void backlightOff() {
  digitalWrite(TFT_LITE, LOW);
}

#define qrCodeURL_HEIGHT 116
#define qrCodeURL_WIDTH 116

